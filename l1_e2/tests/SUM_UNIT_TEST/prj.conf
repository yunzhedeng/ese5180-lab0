## CMakeLists.txt
```
cmake_minimum_required(VERSION 3.20.0)

find_package(Zephyr REQUIRED HINTS $ENV{ZEPHYR_BASE})
project(sum_unit_test)

target_sources(app PRIVATE src/sum_test.c)

if(CONFIG_SUM_LOG)
    target_sources(app PRIVATE ../../sum_log/sum_log.c)
    target_include_directories(app PRIVATE ../../sum_log)
else()
    message(FATAL_ERROR "This test requires CONFIG_SUM_LOG=y")
endif()
```

## prj.conf
```kconfig
CONFIG_ZTEST=y
CONFIG_ZTEST_ASSERT_VERBOSE=2

CONFIG_SERIAL=y
CONFIG_CONSOLE=y
CONFIG_UART_CONSOLE=y
CONFIG_PRINTK=y

CONFIG_LOG=y
CONFIG_LOG_BACKEND_UART=y
CONFIG_LOG_DEFAULT_LEVEL=3

CONFIG_SUM_LOG=y
```

## src/sum_test.c
```c
#include <zephyr/ztest.h>
#include "sum_log.h"

ZTEST(sum_log_test_suite, test_sum_log_basic)
{
    int result = sum_log(3, 5);
    zassert_equal(result, 8, "3 + 5 should equal 8");
}

ZTEST(sum_log_test_suite, test_sum_log_negative)
{
    zassert_equal(sum_log(-3, -5), -8,
                  "-3 + -5 should equal -8");

    zassert_equal(sum_log(-3, 5), 2,
                  "-3 + 5 should equal 2");
}

ZTEST(sum_log_test_suite, test_sum_log_zero)
{
    zassert_equal(sum_log(0, 0), 0, "0 + 0 should equal 0");

    zassert_equal(sum_log(5, 0), 5, "5 + 0 should equal 5");

    zassert_equal(sum_log(0, 5), 5, "0 + 5 should equal 5");
}

ZTEST_SUITE(sum_log_test_suite, NULL, NULL, NULL, NULL, NULL);
```
